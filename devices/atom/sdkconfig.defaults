## devices/bedroom_ceiling/sdkconfig.defaults
```kconfig
CONFIG_ENABLE_SUPERVISOR_BUTTON=y
CONFIG_ENABLE_SUPERVISOR_DEBUG=y
# CONFIG_ENABLE_SUPERVISOR_DS18B20=y
# CONFIG_ENABLE_SUPERVISOR_ESP_NOW_RX=y
# CONFIG_ENABLE_SUPERVISOR_LED=y
CONFIG_ENABLE_SUPERVISOR_LIGHT=y
# CONFIG_ENABLE_SUPERVISOR_RF433=y
# CONFIG_ENABLE_SUPERVISOR_ZIGBEE=y
# CONFIG_ENABLE_SUPERVISOR_NEOPIXEL=y
# CONFIG_ENABLE_SUPERVISOR_LED_INDICATOR=y
# CONFIG_ENABLE_SUPERVISOR_SWITCH=y

CONFIG_BUTTON_GPIO_LIST="18:0:Left,19:0:Right"
CONFIG_LIGHT_GPIO_LIST="S14L:Mains"

# CONFIG_SWITCH_GPIO_LIST="14:0:Mains"


CONFIG_VFS_LITTLEFS_ENABLED=y
```

## devices/bedroom_ceiling/sdkconfig.defaults.inet
```kconfig
# Usage: -DDEVICE_PROFILE=bedroom_ceiling -DDEVICE_PROFILE_VARIANT=inet
CONFIG_ENABLE_SUPERVISOR_INET=y
```

## devices/cikonesp/sdkconfig.defaults
```kconfig
CONFIG_ENABLE_SUPERVISOR_BUTTON=y
CONFIG_ENABLE_SUPERVISOR_DEBUG=y

CONFIG_ENABLE_SUPERVISOR_DS18B20=y
# CONFIG_ENABLE_SUPERVISOR_ESP_NOW_RX=y
CONFIG_ENABLE_SUPERVISOR_LED=y
# CONFIG_ENABLE_SUPERVISOR_RF433=y
# CONFIG_ENABLE_SUPERVISOR_ZIGBEE=y
# CONFIG_ENABLE_SUPERVISOR_NEOPIXEL=y
# CONFIG_ENABLE_SUPERVISOR_LED_INDICATOR=y
CONFIG_ENABLE_SUPERVISOR_SWITCH=y

CONFIG_BUTTON_GPIO_LIST="0:0"
CONFIG_SWITCH_GPIO_LIST="2:0:Board Led"

CONFIG_VFS_LITTLEFS_ENABLED=y
```

## devices/cikonesp/sdkconfig.defaults.inet
```kconfig
# Usage: -DDEVICE_PROFILE=cikonesp -DDEVICE_PROFILE_VARIANT=inet

CONFIG_ENABLE_SUPERVISOR_NETWORK=y
CONFIG_NETWORK_UPLINK_WIFI=y
```

## devices/h2dev/sdkconfig.defaults
```kconfig
CONFIG_DEBUG_CONSOLE=y
CONFIG_ENABLE_SUPERVISOR_NETWORK=y
CONFIG_ENABLE_SUPERVISOR_SWITCH=y

CONFIG_SWITCH_GPIO_LIST="12:1:Fake Switch"
```

## sdkconfig.defaults.dev
```kconfig
CONFIG_SUPERVISOR_TELE_TASKS=y
CONFIG_HTTP_ENABLE_WEBDAV=y
CONFIG_ENABLE_SUPERVISOR_DEBUG=y
```
