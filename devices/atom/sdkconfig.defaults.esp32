## devices/atom/sdkconfig.defaults.inet
```kconfig
# Usage: -DDEVICE_PROFILE=atom -DDEVICE_PROFILE_VARIANT=inet

CONFIG_ENABLE_SUPERVISOR_INET=y

# CONFIG_ENABLE_SUPERVISOR_INET_ETHERNET=y
# Ethernet Hardware Backend
# CONFIG_ETHERNET_W5500=y
```

## devices/atom/sdkconfig.defaults.mesh
```kconfig
# Usage: -DDEVICE_PROFILE=atom -DDEVICE_PROFILE_VARIANT=mesh

CONFIG_ENABLE_SUPERVISOR_INET_MESH=y

# --- ESP-LITE-MESH ---
CONFIG_MESH_LITE_ENABLE=y
CONFIG_MESH_LITE_NODE_INFO_REPORT=y
CONFIG_DEVICE_CATEGORY="sensor"

# --- ESP-LITE-MESH --- # --- FREERTOS / STACK TUNING ---
CONFIG_FREERTOS_TIMER_TASK_STACK_DEPTH=6144

# --- ESP-LITE-MESH --- # --- BRIDGE ---
CONFIG_BRIDGE_ETHERNET_NETIF_ENABLE=n
CONFIG_BRIDGE_SOFTAP_SSID_END_WITH_THE_MAC=y
```

## devices/atom/sdkconfig.defaults.obr
```kconfig
# Usage: -DDEVICE_PROFILE=atom -DDEVICE_PROFILE_VARIANT=obr
CONFIG_ESP_CONSOLE_USB_SERIAL_JTAG=y

# LittleFS — general purpose storage (certs, config, app data).
# CONFIG_VFS_LITTLEFS_ENABLED=y
# SPIFFS — web_storage partition for Thread BR web GUI assets.
CONFIG_VFS_SPIFFS_ENABLED=y

# CONFIG_ENABLE_SUPERVISOR_INET=y #wifi
CONFIG_ENABLE_SUPERVISOR_INET_ETHERNET=y
# Ethernet Hardware Backend
CONFIG_ETHERNET_W5500=y

CONFIG_ENABLE_SUPERVISOR_THREAD_BORDER_ROUTER=y
# eventfd (required by OpenThread)
CONFIG_VFS_EVENTFD_MAX_FDS=5

CONFIG_THREAD_BORDER_ROUTER_WEB=y
CONFIG_OPENTHREAD_COMMISSIONER=y
CONFIG_OPENTHREAD_JOINER=y

# OpenThread (required for Thread BR adapter)
CONFIG_OPENTHREAD_ENABLED=y
CONFIG_OPENTHREAD_BORDER_ROUTER=y
CONFIG_OPENTHREAD_RADIO_SPINEL_UART=y
CONFIG_OPENTHREAD_TASK_SIZE=8192
CONFIG_OPENTHREAD_CLI=y
CONFIG_OPENTHREAD_RCP_COMMAND=y
CONFIG_OPENTHREAD_DNS64_CLIENT=y

# Uncomment for TCP OTA (push-based) — required to buffer large in-flight data over Thread
# CONFIG_OPENTHREAD_NUM_MESSAGE_BUFFERS=256

# LWIP IPv6 forwarding (required for Border Router)
CONFIG_LWIP_MULTICAST_PING=y
CONFIG_LWIP_NETIF_STATUS_CALLBACK=y
CONFIG_LWIP_IPV6_FORWARD=y
CONFIG_LWIP_IPV6_NUM_ADDRESSES=12
CONFIG_LWIP_HOOK_IP6_ROUTE_DEFAULT=y
CONFIG_LWIP_HOOK_ND6_GET_GW_DEFAULT=y
CONFIG_LWIP_HOOK_IP6_INPUT_CUSTOM=y
CONFIG_LWIP_IPV6_AUTOCONFIG=y
CONFIG_LWIP_HOOK_IP6_SELECT_SRC_ADDR_CUSTOM=y
CONFIG_LWIP_FORCE_ROUTER_FORWARDING=y

# mbedTLS for OpenThread
CONFIG_MBEDTLS_ECJPAKE_C=y
CONFIG_MBEDTLS_KEY_EXCHANGE_ECJPAKE=y
CONFIG_MBEDTLS_SSL_PROTO_DTLS=y
CONFIG_MBEDTLS_CMAC_C=y


# WiFi minimal config for ESP-NOW only (no WiFi AP connection needed on atom)
# Default values are tuned for full WiFi stack and waste 50-70KB RAM.
# atom uses W5500 Ethernet for network - WiFi radio is ESP-NOW only.
# CONFIG_ESP_WIFI_STATIC_RX_BUFFER_NUM=2
# CONFIG_ESP_WIFI_DYNAMIC_RX_BUFFER_NUM=4
# CONFIG_ESP_WIFI_DYNAMIC_TX_BUFFER_NUM=2
# CONFIG_ESP_WIFI_MGMT_SBUF_NUM=4
# CONFIG_ESP_WIFI_AMPDU_TX_ENABLED=n
# CONFIG_ESP_WIFI_AMPDU_RX_ENABLED=n
# CONFIG_ESP_WIFI_NVS_ENABLED=n
# CONFIG_ESP_WIFI_SOFTAP_SUPPORT=n
# CONFIG_ESP_WIFI_ENTERPRISE_SUPPORT=n
# CONFIG_ESP_WIFI_ENABLE_WPA3_SAE=n
# CONFIG_ESP_WIFI_ENABLE_SAE_H2E=n
# CONFIG_ESP_WIFI_ENABLE_SAE_PK=n
# CONFIG_ESP_WIFI_ESPNOW_MAX_ENCRYPT_NUM=0
# CONFIG_ESP_WIFI_DYNAMIC_RX_MGMT_BUF=y
# CONFIG_ESP_WIFI_RX_MGMT_BUF_NUM_DEF=2
# CONFIG_ESP_WIFI_STA_DISCONNECTED_PM_ENABLE=n
```

## devices/atom_mesh/sdkconfig.defaults
```kconfig
CONFIG_ENABLE_SUPERVISOR_BUTTON=y
CONFIG_ENABLE_SUPERVISOR_DEBUG=y
# CONFIG_ENABLE_SUPERVISOR_DS18B20=y
# CONFIG_ENABLE_SUPERVISOR_ESP_NOW_RX=y
# CONFIG_ENABLE_SUPERVISOR_INET=y
CONFIG_ENABLE_SUPERVISOR_INET_MESH=y
# CONFIG_ENABLE_SUPERVISOR_LED=y
# CONFIG_ENABLE_SUPERVISOR_RF433=y
# CONFIG_ENABLE_SUPERVISOR_ZIGBEE=y
CONFIG_ENABLE_SUPERVISOR_NEOPIXEL=y

CONFIG_BUTTON_GPIO_LIST="41:0"

# System event task stack size (default 2304 too small for MQTT/HA init in event handlers)
CONFIG_ESP_SYSTEM_EVENT_TASK_STACK_SIZE=3072

CONFIG_TCP_OTA_TASK_STACK_SIZE=5120

# --- ESP-LITE-MESH ---
CONFIG_MESH_LITE_ENABLE=y
CONFIG_MESH_LITE_NODE_INFO_REPORT=y
CONFIG_DEVICE_CATEGORY="sensor"

# --- ESP-LITE-MESH --- # --- FREERTOS / STACK TUNING ---
CONFIG_FREERTOS_TIMER_TASK_STACK_DEPTH=6144

# --- ESP-LITE-MESH --- # --- BRIDGE ---
CONFIG_BRIDGE_ETHERNET_NETIF_ENABLE=n
CONFIG_BRIDGE_SOFTAP_SSID_END_WITH_THE_MAC=y
```

## devices/c6dev/sdkconfig.defaults.ftd
```kconfig
# Usage: -DDEVICE_PROFILE=c6dev -DDEVICE_PROFILE_VARIANT=ftd
# Full Thread Device — router-capable, radio always ON
# Suitable for mains-powered nodes

CONFIG_OPENTHREAD_FTD=y
```

## devices/h2dev/sdkconfig.defaults.ftd
```kconfig
# Usage: -DDEVICE_PROFILE=h2 -DDEVICE_PROFILE_VARIANT=ftd
# Full Thread Device — router-capable, radio always ON
# Suitable for mains-powered nodes

CONFIG_OPENTHREAD_FTD=y
```

## devices/h2dev/sdkconfig.defaults.sed
```kconfig
# Usage: -DDEVICE_PROFILE=h2 -DDEVICE_PROFILE_VARIANT=sed
# Sleepy End Device — MTD with light sleep, battery-friendly
# Polls parent every THREAD_DEVICE_POLL_PERIOD_MS ms, sleeps between polls

CONFIG_OPENTHREAD_MTD=y

# Light sleep power management
CONFIG_PM_ENABLE=y
CONFIG_FREERTOS_USE_TICKLESS_IDLE=y
CONFIG_IEEE802154_SLEEP_ENABLE=y
CONFIG_PM_POWER_DOWN_PERIPHERAL_IN_LIGHT_SLEEP=y
CONFIG_ESP_SLEEP_POWER_DOWN_FLASH=y
CONFIG_FREERTOS_HZ=1000

# MTD doesn't need IPv4
CONFIG_LWIP_IPV4=n
CONFIG_LWIP_ND6=n
```

## devices/p4dev/sdkconfig.defaults
```kconfig
CONFIG_ESPTOOLPY_FLASHSIZE_16MB=y
CONFIG_ESPTOOLPY_FLASHSIZE="16MB"

# ESP32-P4 rev v1.3 silicon (pre-v3.0). Support of <3.0 and >=3.0 is
# mutually exclusive; open the gate and set min revision to v1.0.
CONFIG_ESP32P4_SELECTS_REV_LESS_V3=y
CONFIG_ESP32P4_REV_MIN_100=y

# 32MB HEX (16-line) PSRAM (ESP32-P4NRW32 on M5Stack Unit PoE-P4).
# P4 supports only HEX mode @ 200MHz (both are Kconfig defaults), so no
# CONFIG_SPIRAM_MODE_* / SPEED override is needed here.
CONFIG_SPIRAM=y

CONFIG_ENABLE_SUPERVISOR_DEBUG=y

# Status LED: M5Stack Unit PoE-P4 has an analog 3-pin RGB LED (NH-B2020RGBA),
# common-anode / active-low, on GPIO R:17 G:15 B:16 (per factory firmware
# M5Unit-PoE-P4-UserDemo led_ctrl.h). Pins + active-low are the Kconfig
# defaults for the RGB backend, so only the type switch is needed here.
CONFIG_ENABLE_SUPERVISOR_LED_INDICATOR=y
CONFIG_LED_INDICATOR_RGB=y
```

## devices/p4dev/sdkconfig.defaults.eth
```kconfig
# Usage: -DDEVICE_PROFILE=p4dev -DDEVICE_PROFILE_VARIANT=eth
CONFIG_ESP_CONSOLE_USB_SERIAL_JTAG=y

CONFIG_VFS_LITTLEFS_ENABLED=y

# Ethernet uplink (M5Stack Unit PoE-P4)
CONFIG_ENABLE_SUPERVISOR_INET_ETHERNET=y

# Ethernet hardware backend: ESP32-P4 internal EMAC + IP101GRI PHY over RMII.
# Data-plane pins follow ESP32-P4 IO_MUX defaults; only PHY addr + reset are board-specific.
CONFIG_ETHERNET_ESP_EMAC=y
CONFIG_ETHERNET_PHY_IP101=y
CONFIG_ETHERNET_PHY_ADDR=1
CONFIG_ETHERNET_PHY_RST_GPIO=51
```

## main/Kconfig.projbuild
```kconfig
menu "Cikon App Configuration"

    config ENABLE_SUPERVISOR_BUTTON
        bool "Enable button adapter"
        default n

    config ENABLE_SUPERVISOR_DEBUG
        bool "Enable debug adapter"
        default n

    config ENABLE_SUPERVISOR_INET
        bool "Enable INET adapter"
        default n
        help
            Enable network adapter (WiFi, MQTT, Home Assistant).

    config ENABLE_SUPERVISOR_INET_MESH
        bool "Enable INET Mesh adapter"
        default n
        help
            Enable network mesh adapter (Mesh IF, MQTT, ...).

    config ENABLE_SUPERVISOR_RF433
        bool "Enable RF433 adapter"
        default n
        help
            Enable 433MHz RF receiver adapter.

    config ENABLE_SUPERVISOR_LED
        bool "Enable LED adapter"
        default n

    config ENABLE_SUPERVISOR_DS18B20
        bool "Enable DS18B20 adapter"
        default n

    config ENABLE_SUPERVISOR_ESP_NOW_RX
        bool "Enable ESP-NOW RX adapter"
        default n


    config ENABLE_SUPERVISOR_ZIGBEE
        bool "Enable Zigbee adapter (STUB)"
        default n
        help
            Enable Zigbee coordinator adapter (stub implementation).



endmenu
```

## modules/rf433_receiver/Kconfig
```kconfig
menu "Cikon IoT RF433 Receiver Configuration"

    config RF433_RX_GPIO
        int "RF receiver GPIO pin"
        default 23
        range 0 39
        help
            GPIO pin connected to the 433MHz RF receiver data pin.
            Default: GPIO 23

    config RF433_TASK_STACK_SIZE
        int "RF433 receiver task stack size"
        default 3072
        range 2048 8192
        help
            Stack size (in bytes) for the RF433 receiver task.
            Default: 3072

    config RF433_TASK_PRIORITY
        int "RF433 receiver task priority"
        default 10
        range 1 25
        help
            Priority of the RF433 receiver task.
            Default: 10

    config RF433_DEBOUNCE_MS
        int "RF code debounce time (ms)"
        default 150
        range 50 1000
        help
            Minimum time between accepting the same RF code to prevent duplicates.
            Default: 150ms

    config RF433_RMT_RESOLUTION_HZ
        int "RMT resolution (Hz)"
        default 1000000
        range 500000 10000000
        help
            RMT peripheral tick resolution. Higher = better timing precision.
            Default: 1000000 (1 tick = 1µs)

    config RF433_RMT_MEM_BLOCK_SYMBOLS
        int "RMT memory block symbols"
        default 64
        range 48 256
        help
            Number of RMT symbols to buffer. Should be enough for one complete RF frame.
            Default: 64

endmenu
```

## sdkconfig.defaults
```kconfig
CONFIG_FREERTOS_GENERATE_RUN_TIME_STATS=y

CONFIG_ESPTOOLPY_FLASHSIZE_4MB=y
CONFIG_ESPTOOLPY_FLASHSIZE="4MB"

CONFIG_PARTITION_TABLE_CUSTOM=y
CONFIG_PARTITION_TABLE_CUSTOM_FILENAME="partition_table/partition_table.csv"

# Core dump configuration
CONFIG_ESP_COREDUMP_ENABLE_TO_FLASH=y

CONFIG_LWIP_SNTP_MAX_SERVERS=3
CONFIG_BOOTLOADER_APP_ROLLBACK_ENABLE=y

# TLS/MQTT Memory Optimization
# Default mbedTLS uses 16KB input + 4KB output = 20KB just for TLS buffers!
# For IoT MQTT/HTTPS: 2KB input + 4KB output is sufficient (saves 12KB RAM)
# - MQTT messages: typically <1KB (sensor data, commands, HA discovery)
# - HTTPS JSON responses: typically <2KB (telemetry, system info)
# - Large messages get fragmented (adds ~10-20ms, rarely happens)
CONFIG_MBEDTLS_ASYMMETRIC_CONTENT_LEN=y
CONFIG_MBEDTLS_SSL_IN_CONTENT_LEN=2048
CONFIG_MBEDTLS_SSL_OUT_CONTENT_LEN=4096

# System event task stack size (default 2304 too small for MQTT/HA init in event handlers)
CONFIG_ESP_SYSTEM_EVENT_TASK_STACK_SIZE=3072

CONFIG_TCP_OTA_TASK_STACK_SIZE=5120
```
